## example/Kconfig
```kconfig
# Example Kconfig file

mainmenu "Example project for $(ARCH) configuration"

source "arch/$(SRCARCH)/Kconfig"
source "tools/Kconfig"
```

## example/arch/arm/Kconfig
```kconfig
# Example Kconfig file in ARCH

config ARM
  bool
  default y

source "kernel/Kconfig"
```

## example/arch/x86_64/Kconfig
```kconfig
# Example Kconfig file in ARCH

config X86_64
  bool
  default y

source "kernel/Kconfig"
```

## example/kernel/Kconfig
```kconfig
# Example Kconfig file for kernel

choice

  prompt "GCC optimization level"
  default CC_OPTIMIZE_O2

  config CC_OPTIMIZE_O0
    bool "Use -O0"
  config CC_OPTIMIZE_O1
    bool "Use -O1"
  config CC_OPTIMIZE_O2
    bool "Use -O2"

endchoice
```

## example/tools/Kconfig
```kconfig
# Example Kconfig file

menu "Example kconfig options in tools/"

config EXAMPLE_OPTION
  bool "This is an example option in KBUILD_STANDALONE_SRCDIRS"
  default y

endmenu
```
